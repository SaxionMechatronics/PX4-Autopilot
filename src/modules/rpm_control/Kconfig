## src/modules/rpm_control/Kconfig
```kconfig
menuconfig MODULES_RPM_CONTROL
    bool "RPM Control Module"
    default n
    help
        Closed-loop RPM-based motor control using BDShot telemetry.
```
